## conf/machine/alphatriplehd.conf
```bitbake
#@TYPE: Machine
#@NAME: SAB Alpha Triple HD BOX 
#@DESCRIPTION: Machine configuration for the SAB Alphatriple

IMAGEDIR ?= "sab_alpha_triple"

PREFERRED_VERSION_linux-${MACHINE} = "4.1.24"

MKUBIFS_ARGS = "-m 2048 -e 126976 -c 8192"
UBINIZE_ARGS = "-m 2048 -p 128KiB"

MACHINE_FEATURES += "dvb-c ci textlcd blindscan-dvbc"

CHIPSET = "bcm7241"
FORCE_REBOOT_OPTION = "reboot"

require conf/machine/include/alphatriplehd.inc
```

## meta-hd/conf/machine/sbalphatriplehd.conf
```bitbake
#@TYPE: Machine
#@NAME: SAB BOX 
#@DESCRIPTION: Machine configuration for the SAB Alphatriple

IMAGEDIR ?= "sabbox/alphatriplehd"

PREFERRED_VERSION_linux-${MACHINE} = "4.1.24"

MKUBIFS_ARGS = "-m 2048 -e 126976 -c 8192"
UBINIZE_ARGS = "-m 2048 -p 128KiB"

MACHINE_FEATURES += "dvb-c ci textlcd blindscan-dvbc"

CHIPSET = "bcm7241"
FORCE_REBOOT_OPTION = "reboot"

require conf/machine/include/sabbox.inc
```
